/*
 * Copyright (c) 2026 amgskobo
 * SPDX-License-Identifier: MIT
 *
 * The peripheral's pad, scripted as (delay-ms type code value sync);
 * nrf52_bsim.keymap has the timeline. It reports every 20 ms while touched.
 */

#include "shared.dtsi"

/ {
    pad: pad {
        compatible = "zmk,test-input-script";
        events = <
            /* 4.0 s to 4.3 s: a contact on the left edge. */
            TOUCH(4000, 10, 500) POS(20, 10, 501) POS(20, 10, 502) POS(20, 10, 500) POS(20, 10, 501)
            POS(20, 10, 502) POS(20, 10, 500) POS(20, 10, 501) POS(20, 10, 502) POS(20, 10, 500)
            POS(20, 10, 501) POS(20, 10, 502) POS(20, 10, 500) POS(20, 10, 501) POS(20, 10, 502)
            POS(20, 10, 500) LIFT(20)
            /* 5.0 s to 5.3 s: a contact in the middle. */
            TOUCH(680, 500, 500) POS(20, 500, 501) POS(20, 500, 502) POS(20, 500, 500)
            POS(20, 500, 501) POS(20, 500, 502) POS(20, 500, 500) POS(20, 500, 501)
            POS(20, 500, 502) POS(20, 500, 500) POS(20, 500, 501) POS(20, 500, 502)
            POS(20, 500, 500) POS(20, 500, 501) POS(20, 500, 502) POS(20, 500, 500) LIFT(20)
            /* 6.0 s to 12.0 s: a contact on the left edge, through the outage. */
            TOUCH(680, 10, 500) POS(20, 10, 501) POS(20, 10, 502) POS(20, 10, 500) POS(20, 10, 501)
            POS(20, 10, 502) POS(20, 10, 500) POS(20, 10, 501) POS(20, 10, 502) POS(20, 10, 500)
            POS(20, 10, 501) POS(20, 10, 502) POS(20, 10, 500) POS(20, 10, 501) POS(20, 10, 502)
            POS(20, 10, 500) POS(20, 10, 501) POS(20, 10, 502) POS(20, 10, 500) POS(20, 10, 501)
            POS(20, 10, 502) POS(20, 10, 500) POS(20, 10, 501) POS(20, 10, 502) POS(20, 10, 500)
            POS(20, 10, 501) POS(20, 10, 502) POS(20, 10, 500) POS(20, 10, 501) POS(20, 10, 502)
            POS(20, 10, 500) POS(20, 10, 501) POS(20, 10, 502) POS(20, 10, 500) POS(20, 10, 501)
            POS(20, 10, 502) POS(20, 10, 500) POS(20, 10, 501) POS(20, 10, 502) POS(20, 10, 500)
            POS(20, 10, 501) POS(20, 10, 502) POS(20, 10, 500) POS(20, 10, 501) POS(20, 10, 502)
            POS(20, 10, 500) POS(20, 10, 501) POS(20, 10, 502) POS(20, 10, 500) POS(20, 10, 501)
            POS(20, 10, 502) POS(20, 10, 500) POS(20, 10, 501) POS(20, 10, 502) POS(20, 10, 500)
            POS(20, 10, 501) POS(20, 10, 502) POS(20, 10, 500) POS(20, 10, 501) POS(20, 10, 502)
            POS(20, 10, 500) POS(20, 10, 501) POS(20, 10, 502) POS(20, 10, 500) POS(20, 10, 501)
            POS(20, 10, 502) POS(20, 10, 500) POS(20, 10, 501) POS(20, 10, 502) POS(20, 10, 500)
            POS(20, 10, 501) POS(20, 10, 502) POS(20, 10, 500) POS(20, 10, 501) POS(20, 10, 502)
            POS(20, 10, 500) POS(20, 10, 501) POS(20, 10, 502) POS(20, 10, 500) POS(20, 10, 501)
            POS(20, 10, 502) POS(20, 10, 500) POS(20, 10, 501) POS(20, 10, 502) POS(20, 10, 500)
            POS(20, 10, 501) POS(20, 10, 502) POS(20, 10, 500) POS(20, 10, 501) POS(20, 10, 502)
            POS(20, 10, 500) POS(20, 10, 501) POS(20, 10, 502) POS(20, 10, 500) POS(20, 10, 501)
            POS(20, 10, 502) POS(20, 10, 500) POS(20, 10, 501) POS(20, 10, 502) POS(20, 10, 500)
            POS(20, 10, 501) POS(20, 10, 502) POS(20, 10, 500) POS(20, 10, 501) POS(20, 10, 502)
            POS(20, 10, 500) POS(20, 10, 501) POS(20, 10, 502) POS(20, 10, 500) POS(20, 10, 501)
            POS(20, 10, 502) POS(20, 10, 500) POS(20, 10, 501) POS(20, 10, 502) POS(20, 10, 500)
            POS(20, 10, 501) POS(20, 10, 502) POS(20, 10, 500) POS(20, 10, 501) POS(20, 10, 502)
            POS(20, 10, 500) POS(20, 10, 501) POS(20, 10, 502) POS(20, 10, 500) POS(20, 10, 501)
            POS(20, 10, 502) POS(20, 10, 500) POS(20, 10, 501) POS(20, 10, 502) POS(20, 10, 500)
            POS(20, 10, 501) POS(20, 10, 502) POS(20, 10, 500) POS(20, 10, 501) POS(20, 10, 502)
            POS(20, 10, 500) POS(20, 10, 501) POS(20, 10, 502) POS(20, 10, 500) POS(20, 10, 501)
            POS(20, 10, 502) POS(20, 10, 500) POS(20, 10, 501) POS(20, 10, 502) POS(20, 10, 500)
            POS(20, 10, 501) POS(20, 10, 502) POS(20, 10, 500) POS(20, 10, 501) POS(20, 10, 502)
            POS(20, 10, 500) POS(20, 10, 501) POS(20, 10, 502) POS(20, 10, 500) POS(20, 10, 501)
            POS(20, 10, 502) POS(20, 10, 500) POS(20, 10, 501) POS(20, 10, 502) POS(20, 10, 500)
            POS(20, 10, 501) POS(20, 10, 502) POS(20, 10, 500) POS(20, 10, 501) POS(20, 10, 502)
            POS(20, 10, 500) POS(20, 10, 501) POS(20, 10, 502) POS(20, 10, 500) POS(20, 10, 501)
            POS(20, 10, 502) POS(20, 10, 500) POS(20, 10, 501) POS(20, 10, 502) POS(20, 10, 500)
            POS(20, 10, 501) POS(20, 10, 502) POS(20, 10, 500) POS(20, 10, 501) POS(20, 10, 502)
            POS(20, 10, 500) POS(20, 10, 501) POS(20, 10, 502) POS(20, 10, 500) POS(20, 10, 501)
            POS(20, 10, 502) POS(20, 10, 500) POS(20, 10, 501) POS(20, 10, 502) POS(20, 10, 500)
            POS(20, 10, 501) POS(20, 10, 502) POS(20, 10, 500) POS(20, 10, 501) POS(20, 10, 502)
            POS(20, 10, 500) POS(20, 10, 501) POS(20, 10, 502) POS(20, 10, 500) POS(20, 10, 501)
            POS(20, 10, 502) POS(20, 10, 500) POS(20, 10, 501) POS(20, 10, 502) POS(20, 10, 500)
            POS(20, 10, 501) POS(20, 10, 502) POS(20, 10, 500) POS(20, 10, 501) POS(20, 10, 502)
            POS(20, 10, 500) POS(20, 10, 501) POS(20, 10, 502) POS(20, 10, 500) POS(20, 10, 501)
            POS(20, 10, 502) POS(20, 10, 500) POS(20, 10, 501) POS(20, 10, 502) POS(20, 10, 500)
            POS(20, 10, 501) POS(20, 10, 502) POS(20, 10, 500) POS(20, 10, 501) POS(20, 10, 502)
            POS(20, 10, 500) POS(20, 10, 501) POS(20, 10, 502) POS(20, 10, 500) POS(20, 10, 501)
            POS(20, 10, 502) POS(20, 10, 500) POS(20, 10, 501) POS(20, 10, 502) POS(20, 10, 500)
            POS(20, 10, 501) POS(20, 10, 502) POS(20, 10, 500) POS(20, 10, 501) POS(20, 10, 502)
            POS(20, 10, 500) POS(20, 10, 501) POS(20, 10, 502) POS(20, 10, 500) POS(20, 10, 501)
            POS(20, 10, 502) POS(20, 10, 500) POS(20, 10, 501) POS(20, 10, 502) POS(20, 10, 500)
            POS(20, 10, 501) POS(20, 10, 502) POS(20, 10, 500) POS(20, 10, 501) POS(20, 10, 502)
            POS(20, 10, 500) POS(20, 10, 501) POS(20, 10, 502) POS(20, 10, 500) POS(20, 10, 501)
            POS(20, 10, 502) POS(20, 10, 500) POS(20, 10, 501) POS(20, 10, 502) POS(20, 10, 500)
            POS(20, 10, 501) POS(20, 10, 502) POS(20, 10, 500) POS(20, 10, 501) POS(20, 10, 502)
            POS(20, 10, 500) POS(20, 10, 501) POS(20, 10, 502) POS(20, 10, 500) POS(20, 10, 501)
            POS(20, 10, 502) POS(20, 10, 500) POS(20, 10, 501) POS(20, 10, 502) POS(20, 10, 500)
            POS(20, 10, 501) POS(20, 10, 502) POS(20, 10, 500) POS(20, 10, 501) POS(20, 10, 502)
            POS(20, 10, 500) POS(20, 10, 501) POS(20, 10, 502) POS(20, 10, 500) POS(20, 10, 501)
            POS(20, 10, 502) POS(20, 10, 500) POS(20, 10, 501) POS(20, 10, 502) POS(20, 10, 500)
            POS(20, 10, 501) POS(20, 10, 502) POS(20, 10, 500) POS(20, 10, 501) POS(20, 10, 502)
            POS(20, 10, 500) LIFT(20)
        >;
    };
};

&split_input {
    device = <&pad>;
};
